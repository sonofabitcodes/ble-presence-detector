## main/Kconfig.projbuild
```kconfig
menu "BLE Presence Detector Configuration"

    config PRESENCE_DETECTOR_NAME
        string "Device name"
        default "PRESENCE_DETECTOR"
        help
            Device name. Used in mqtt topic and json result.

    config GET_URLS_FROM_BROADCAST
        bool "Register client over broadcast and get mqtt and http urls from server"
        default y

    config REGISTER_BROADCAST_PORT
        int "Register server port"
        depends on GET_URLS_FROM_BROADCAST
        default 20000

    config HTTP_POST_PUBLISH_URL
        string "Http protocol publish url"
        depends on !GET_URLS_FROM_BROADCAST
        default "http://example.com"

    config MQTT_BROKER_URL
        string "Mqtt broker url"
        depends on !GET_URLS_FROM_BROADCAST
        default "mqtt://iot.eclipse.org"

    choice PUBLISH_PROTOCOLS
        bool "Publishing Protocol"
        default PUBLISH_PROTOCOL_MQTT
        help
            Select the protocol used to publish found devices.

        config PUBLISH_PROTOCOL_MQTT
            bool "MQTT"
            help
                Message Queuing Telemetry Transport (MQTT)

        config PUBLISH_PROTOCOL_HTTP_POST
            bool "HTTP"
            help
                HTTP POST request.

        config PUBLISH_PROTOCOL_ALL
            bool "MQTT and HTTP"
            help
                Use both, MQTT and HTTP POST request.
    endchoice

    config PUBLISH_PROTOCOLS
        int
        default 0 if PUBLISH_PROTOCOL_MQTT
        default 1 if PUBLISH_PROTOCOL_HTTP_POST
        default 2 if PUBLISH_PROTOCOL_ALL

    config BLE_SCAN_DURATION
        int "Bluetooth scan duration"
        default 15
        help
            Duration in seconds for scanning devices
    config BLE_SCAN_INTERVAL
        int "Bluetooth scan interval"
        default 60
        help
            Interval in seconds to scan for devices

    menu "WIFI"

        config WIFI_SSID
            string "WiFi SSID"
            default "myssid"
            help
                SSID (network name) to connect to.

        config WIFI_PASSWORD
            string "WiFi Password"
            default "mypassword"
            help
                WiFi password (WPA or WPA2) to use.
    endmenu

    choice LOG_LEVEL
        bool "Log level"
        default LOG_LEVEL_INFO
        help
            Select the log level Mode.

        config LOG_LEVEL_NONE
            bool "No logs"
            help
                No log output.

        config LOG_LEVEL_ERROR
            bool "Errors"
            help
                Critical errors, software module can not recover on its own.

        config LOG_LEVEL_WARN
            bool "Warnings"
            help
                Error conditions from which recovery measures have been taken.

        config LOG_LEVEL_INFO
            bool "Info"
            help
                Information messages which describe normal flow of events.

        config LOG_LEVEL_DEBUG
            bool "Debug messages"
            help
                Extra information which is not necessary for normal use.

        config LOG_LEVEL_VERBOSE
            bool "All"
            help
                Bigger chunks of debugging information, or frequent messages which can potentially flood the output.

    endchoice

    config LOG_LEVEL
        int
        default 0 if LOG_LEVEL_NONE
        default 1 if LOG_LEVEL_ERROR
        default 2 if LOG_LEVEL_WARN
        default 3 if LOG_LEVEL_INFO
        default 4 if LOG_LEVEL_DEBUG
        default 5 if LOG_LEVEL_VERBOSE
endmenu
```
